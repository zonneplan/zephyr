## soc/arm/atmel_sam0/common/Kconfig.samd2x
```kconfig
# SPDX-License-Identifier: Apache-2.0

if SOC_SERIES_SAMD20 || SOC_SERIES_SAMD21 || SOC_SERIES_SAMR21

config SOC_ATMEL_SAMD_XOSC32K
	bool "Enable the external 32 kHz crystal oscillator"
	help
	  Say y to enable the external 32 kHZ crystal oscillator at
	  startup.  This can then be selected as the main clock source
	  for the SOC.

config SOC_ATMEL_SAMD_XOSC
	bool "Enable the external crystal oscillator"
	help
	  Say y to enable the external crystal oscillator at startup.

choice
	prompt "Main clock source"
	help
	  Selects the clock that the main clocks, such as the CPU
	  clock and AHB clock, will be derived from.

config SOC_ATMEL_SAMD_XOSC32K_AS_MAIN
	depends on SOC_ATMEL_SAMD_XOSC32K
	bool "XOSC32K"

config SOC_ATMEL_SAMD_XOSC_AS_MAIN
	depends on SOC_ATMEL_SAMD_XOSC
	bool "XOSC"

config SOC_ATMEL_SAMD_OSC8M_AS_MAIN
	bool "OSC8M"

config SOC_ATMEL_SAMD_OSC32K_AS_MAIN
	bool "OSC32K"
endchoice

config SOC_ATMEL_SAMD_ENABLE_BOD33
	bool "BOD33"

choice
	prompt "BOD33 level"
	help
	  Selects the voltage at which the brown out will leave reset state.
	  for the exact voltages see the datasheet table 37-21

	config SOC_ATMEL_SAMD_BOD33_V1_72
		bool "BOD33_V1_72"
	config SOC_ATMEL_SAMD_BOD33_V1_76
		bool "BOD33_V1_76"
	config SOC_ATMEL_SAMD_BOD33_V2_89
		bool "BOD33_V2_89"
	config SOC_ATMEL_SAMD_BOD33_V3_25
		bool "BOD33_V3_25"
endchoice

endif # SOC_SERIES_SAMD20 || SOC_SERIES_SAMD21
```
